## main/Kconfig.projbuild
```kconfig
menu "Dotii 桌面交互屏"

    config STATE_DISPLAY_DEMO_MODE
        bool "Show clearly labelled preview data when the bridge is unavailable"
        default y

    config STATE_DISPLAY_WIFI_SSID
        string "Wi-Fi SSID"
        default ""

    config STATE_DISPLAY_WIFI_PASSWORD
        string "Wi-Fi password"
        default ""

    config STATE_DISPLAY_BRIDGE_URL
        string "Bridge snapshot URL"
        default ""
        help
            Example: http://192.168.1.20:8787/api/v1/snapshot

    config STATE_DISPLAY_BRIDGE_TOKEN
        string "Bridge token"
        default "change-me"

    config STATE_DISPLAY_POLL_SECONDS
        int "Bridge polling interval in seconds"
        range 2 300
        default 5

    config STATE_DISPLAY_STALE_SECONDS
        int "Mark source stale after seconds"
        range 15 86400
        default 120

    config STATE_DISPLAY_TIMEZONE
        string "POSIX timezone"
        default "CST-8"
        help
            CST-8 is Asia/Shanghai without daylight-saving time.

endmenu
```

## sdkconfig.defaults
```kconfig
CONFIG_ESPTOOLPY_FLASHMODE_QIO=y
CONFIG_ESPTOOLPY_FLASHSIZE_16MB=y
CONFIG_PARTITION_TABLE_CUSTOM=y
CONFIG_PARTITION_TABLE_CUSTOM_FILENAME="partitions.csv"
CONFIG_COMPILER_OPTIMIZATION_PERF=y
CONFIG_SPIRAM=y
CONFIG_SPIRAM_MODE_OCT=y
CONFIG_SPIRAM_FETCH_INSTRUCTIONS=y
CONFIG_SPIRAM_RODATA=y
CONFIG_SPIRAM_SPEED_80M=y
CONFIG_SPIRAM_XIP_FROM_PSRAM=y
CONFIG_SPIRAM_ALLOW_BSS_SEG_EXTERNAL_MEMORY=y
CONFIG_ESP32S3_INSTRUCTION_CACHE_32KB=y
CONFIG_ESP32S3_DATA_CACHE_64KB=y
CONFIG_ESP32S3_DATA_CACHE_LINE_64B=y
CONFIG_ESP_DEFAULT_CPU_FREQ_MHZ_240=y
CONFIG_FREERTOS_HZ=1000
CONFIG_LV_USE_CLIB_MALLOC=y
CONFIG_LV_USE_CLIB_STRING=y
CONFIG_LV_USE_CLIB_SPRINTF=y
CONFIG_LV_DEF_REFR_PERIOD=16
CONFIG_LV_OS_FREERTOS=y
CONFIG_LV_OBJ_STYLE_CACHE=y
CONFIG_LV_DRAW_SW_DRAW_UNIT_CNT=2
CONFIG_LV_ATTRIBUTE_FAST_MEM_USE_IRAM=y
CONFIG_LV_FONT_MONTSERRAT_14=y
CONFIG_LV_FONT_MONTSERRAT_16=y
CONFIG_LV_FONT_MONTSERRAT_18=y
CONFIG_LV_FONT_MONTSERRAT_20=y
CONFIG_LV_FONT_MONTSERRAT_22=y
CONFIG_LV_FONT_MONTSERRAT_28=y
CONFIG_LV_FONT_MONTSERRAT_32=y
CONFIG_LV_USE_FONT_COMPRESSED=y
CONFIG_LV_TXT_ENC_UTF8=y
CONFIG_LV_TXT_BREAK_CHARS=" ,.;:-_"
# CONFIG_LV_BUILD_EXAMPLES is not set
# CONFIG_LV_BUILD_DEMOS is not set
CONFIG_LV_USE_ARC=y
CONFIG_LV_USE_BAR=y
CONFIG_LV_USE_BUTTON=y
CONFIG_LV_USE_LABEL=y
CONFIG_LV_USE_SLIDER=y
CONFIG_LV_USE_SWITCH=y
CONFIG_LV_USE_FLEX=y
CONFIG_LV_USE_GRID=y
CONFIG_ESP_MAIN_TASK_STACK_SIZE=8192
CONFIG_MBEDTLS_CERTIFICATE_BUNDLE=y
CONFIG_ESP_HTTP_CLIENT_ENABLE_HTTPS=y
CONFIG_LWIP_DHCP_DOES_ARP_CHECK=y
CONFIG_STATE_DISPLAY_DEMO_MODE=y
CONFIG_STATE_DISPLAY_POLL_SECONDS=5
CONFIG_STATE_DISPLAY_STALE_SECONDS=120
CONFIG_BT_ENABLED=y
CONFIG_BT_NIMBLE_ENABLED=y
CONFIG_BT_NIMBLE_MAX_CONNECTIONS=1
CONFIG_BT_NIMBLE_GAP_SERVICE=y
CONFIG_BT_NIMBLE_NVS_PERSIST=y
CONFIG_BT_NIMBLE_MEM_ALLOC_MODE_EXTERNAL=y
# CONFIG_BT_NIMBLE_ROLE_CENTRAL is not set
# CONFIG_BT_NIMBLE_ROLE_OBSERVER is not set
CONFIG_BT_NIMBLE_ATT_PREFERRED_MTU=185
CONFIG_BT_CTRL_RUN_IN_FLASH_ONLY=y
# CONFIG_BT_CTRL_DTM_ENABLE is not set
# CONFIG_BT_CTRL_BLE_SCAN is not set
```
